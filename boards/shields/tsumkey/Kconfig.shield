## boards/shields/tsumkey/Kconfig.shield
```kconfig
config SHIELD_TSUMKEY_R
    def_bool $(shields_list_contains,tsumkey_r)

config SHIELD_TSUMKEY_L
    def_bool $(shields_list_contains,tsumkey_l)
```

## config/west.yml
```yaml
manifest:
  remotes:
    - name: zmkfirmware
      url-base: https://github.com/zmkfirmware
    - name: j-baba
      url-base: https://github.com/j-baba
    - name: caksoylar
      url-base: https://github.com/caksoylar  
  projects:
    - name: zmk
      remote: zmkfirmware
      revision: main
      import: app/west.yml
    - name: zmk-rgbled-widget
      remote: caksoylar
      revision: main
  self:
    path: config
```
